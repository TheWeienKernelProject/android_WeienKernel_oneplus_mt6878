## arch/arm64/configs/perf_defconfig
```kconfig
CONFIG_LOCALVERSION="-perf"

#
# CPU Frequency scaling
#
# CONFIG_CPU_FREQ_DEFAULT_GOV_SCHEDUTIL is not set
CONFIG_CPU_FREQ_GOV_PERFORMANCE=y
CONFIG_CPU_FREQ_DEFAULT_GOV_PERFORMANCE=y

#
# General architecture-dependent options
#
CONFIG_PGO=y

#
# SLAB allocator options
#
CONFIG_KSM=y

#
# Kernel Features
#
CONFIG_SCHED_CLUSTER=y

#
# Scheduler features
#
CONFIG_SCHED_AUTOGROUP=y
```

## drivers/wktools/Kconfig
```kconfig
menuconfig WK_FUTURE
    bool "WK Future Support"
    default y
    help
      Enable WK Future feature support.

if WK_FUTURE

config WK_FUTURE_EXP_PROTECT_PARTITION
    bool "Protect some devices partition"
    default n
    help
      protect device partition.

endif
```
